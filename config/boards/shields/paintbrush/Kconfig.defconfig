## config/boards/shields/paintbrush/Kconfig.defconfig
```kconfig
if SHIELD_PAINTBRUSH

config ZMK_KEYBOARD_NAME
    default "Paintbrush"

config SHIELD_PAINTBRUSH
    def_bool $(shields_list_contains,paintbrush)

endif
```
